## arch/arm/soc/bcm_lynx/Kconfig
```kconfig
#
# Copyright (c) 2017, Broadcom
#
# SPDX-License-Identifier: Apache-2.0
#

config SOC_FAMILY_LYNX
	bool
	# omit prompt to signify a "hidden" option
	default n

if SOC_FAMILY_LYNX
config SOC_FAMILY
	string
	default "bcm_lynx"
endif

source "arch/arm/soc/bcm_lynx/*/Kconfig.soc"
```

## arch/arm/soc/bcm_lynx/Kconfig.soc
```kconfig
#
# Copyright (c) 2017 Broadcom
#
# SPDX-License-Identifier: Apache-2.0
#

source "arch/arm/soc/bcm_lynx/*/Kconfig.series"
```

## arch/arm/soc/bcm_lynx/bcm5810x/Kconfig.defconfig.series
```kconfig
#
# Copyright (c) 2017 Broadcom
#
# SPDX-License-Identifier: Apache-2.0
#

if SOC_SERIES_LYNX

config SOC_SERIES
	default bcm5810x

config NUM_IRQS
	int
	default 45

config SYS_CLOCK_HW_CYCLES_PER_SEC
	int
	default 250000000

endif # SOC_SERIES_LYNX
```

## arch/arm/soc/bcm_lynx/bcm5810x/Kconfig.series
```kconfig
# Kconfig - Broadcom Lynx MCU series
#
# Copyright (c) 2017, Broadcom
#
# SPDX-License-Identifier: Apache-2.0
#

config SOC_SERIES_LYNX
	bool "Broadcom Lynx Series MCU"
	select CPU_CORTEX_M
	select SOC_FAMILY_LYNX
	select CPU_CORTEX_M3
	select CPU_HAS_SYSTICK
	select CPU_HAS_MPU
	help
	 Enable support for Beetle MCU Series
	help
	  Enable support for Broadcom Lynx MCU series
```

## arch/arm/soc/bcm_lynx/bcm5810x/Kconfig.soc
```kconfig
# Kconfig - Lynx SoC
#
# Copyright (c) 2017, Broadcom
#
# SPDX-License-Identifier: Apache-2.0
#

choice
prompt "Broadcom Lynx MCU Selection"
depends on SOC_SERIES_LYNX

config SOC_5810X
	bool "SOC_5810X"
	select CPU_CORTEX_M3

endchoice

config ARM_MPU_ENABLE
	bool "Enable MPU"
	depends on CPU_HAS_MPU
	select ARM_MPU
	default n
	help
	  Enable MPU
```

## boards/arm/bcm958100k/Kconfig.defconfig
```kconfig
#
# Copyright (c) 2017 Broadcom
#
# SPDX-License-Identifier: Apache-2.0
#

if BOARD_BCM958100K

config BOARD
	default bcm958100k

config SRAM_BASE_ADDRESS
	default 0x00000000

config SRAM_SIZE
	default 0

if UART_NS16550

config UART_NS16550_PORT_0
	def_bool y

if UART_NS16550_PORT_0

config UART_NS16550_PORT_0_NAME
	default "UART_0"
config UART_NS16550_PORT_0_IRQ_PRI
	default 1
config UART_NS16550_PORT_0_BAUD_RATE
	default 115200
config UART_NS16550_PORT_0_OPTIONS
	default 0

endif # UART_NS16550_PORT_0

if UART_NS16550_PORT_1

config UART_NS16550_PORT_1_NAME
	default "UART_1"
config UART_NS16550_PORT_1_IRQ_PRI
	default 1
config UART_NS16550_PORT_1_BAUD_RATE
	default 115200
config UART_NS16550_PORT_1_OPTIONS
	default 0

endif # UART_NS16550_PORT_1

endif # UART_NS16550

if UART_CONSOLE

config UART_CONSOLE_ON_DEV_NAME
	default "UART_0"

endif

endif # BOARD_BCM958100K
```

## boards/arm/bcm958100k/bcm958100k_defconfig
```kconfig
CONFIG_ARM=y
CONFIG_ARCH="arm"
CONFIG_SOC_FAMILY="bcm_lynx"
CONFIG_BOARD="bcm958100k"
CONFIG_SOC_SERIES_LYNX=y
CONFIG_SOC_FAMILY_LYNX=y
CONFIG_SOC_5810X=y
CONFIG_SYS_CLOCK_HW_CYCLES_PER_SEC=25000000
CONFIG_BOARD_BCM958100K=y
CONFIG_CONSOLE=y
CONFIG_UART_CONSOLE=y
CONFIG_SERIAL=y
CONFIG_UART_NS16550=y
CONFIG_DEBUG=y
CONFIG_PRINTK=y
CONFIG_EARLY_CONSOLE=y
CONFIG_CORTEX_M_SYSTICK=y
CONFIG_XIP=n
CONFIG_ARM_CORE_MPU=n
CONFIG_MPU_STACK_GUARD=n
CONFIG_ARM_MPU=n
```
